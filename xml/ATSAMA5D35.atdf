# ATSAMA5D35 device description
Architecture: CORTEX-A5; Family: SAMA5
Programming and debug interfaces: JTAG
Registers are 32-bit, read-write, no defined reset value unless marked. A register's access mark holds for its fields unless they carry their own. Offsets are from the block's base; lines under a group give offsets from that group; [hi:lo] are bit positions; {n}, {i} and the like mark numbered series; 'fields as' and 'values as' point back to an identical list; <NAME> marks a mode.

## Ordering variants
ATSAMA5D35-CU: BGA324, +0 to +0 C, +0 to +0 V

## Memory
base space: start 0 size 0x100000000, little endian
  0x10000000 EBI_CS0 size 0x10000000 other
  0x20000000 DDR_CS size 0x20000000 other
  0x40000000 EBI_CS1 size 0x10000000 other
  0x50000000 EBI_CS2 size 0x10000000 other
  0x60000000 EBI_CS3 size 0x10000000 other
  0x60000000 EBI_NF size 0x10000000 other
  0x70000000 NFC size 0x10000000 other
  0x00100000 IROM size 0x00020000 rom
  0x00300000 IRAM0 size 0x00010000 ram
  0x00310000 IRAM1 size 0x00010000 ram
  0x00400000 SMD size 0x00100000 other
  0x00500000 UDPHS_RAM size 0x00100000 other
  0x00600000 UHP_OHCI size 0x00100000 other
  0x00700000 UHP_EHCI size 0x00100000 other
  0x00800000 AXIMX size 0x00100000 other
  0x00900000 DAP size 0x00100000 other

## Peripheral instances (address, pins/pin function, parameters)
ADC at 0xF8018000
  pins: ADTRG PD19/A; AD{n} PD{n+20}/A (n=0..11)
AIC at 0xFFFFF000
  pins: FIQ PC31/A; IRQ PE31/A
AXIMX at 0x00800000
BSC at 0xFFFFFE54
CAN0 at 0xF000C000 (CAN)
  pins: CANRX0 PD14/C; CANTX0 PD15/C
CAN1 at 0xF8010000 (CAN)
  pins: CANRX1 PB14/B; CANTX1 PB15/B
DBGU at 0xFFFFEE00
  pins: DRXD PB30/A; DTXD PB31/A
DMAC0 at 0xFFFFE600 (DMAC)
DMAC1 at 0xFFFFE800 (DMAC)
EMAC at 0xF802C000
  pins: ECRSDV PC5/A; EMDC PC8/A; EMDIO PC9/A; EREFCK PC7/A; ERXER PC6/A; ERX0 PC2/A; ERX1 PC3/A; ETXEN PC4/A; ETX0 PC0/A; ETX1 PC1/A
FUSE at 0xFFFFE400
GMAC at 0xF0028000
  pins: GCOL PB15/A; GCRS PB14/A; GMDC PB16/A; GMDIO PB17/A; GRXCK PB11/A; GRXDV PB12/A; GRXER PB13/A; GRX0 PB4/A; GRX1 PB5/A; GRX2 PB6/A; GRX3 PB7/A; GRX4 PB23/B; GRX5 PB24/B; GRX6 PB25/B; GRX7 PB26/B; GTXCK PB8/A; GTXEN PB9/A; GTXER PB10/A; GTX0 PB0/A; GTX1 PB1/A; GTX2 PB2/A; GTX3 PB3/A; GTX4 PB19/B; GTX5 PB20/B; GTX6 PB21/B; GTX7 PB22/B; G125CK PB18/A; G125CKO PB27/B
GPBR at 0xFFFFFE60
HSMCI0 at 0xF0000000 (HSMCI)
  pins: MCI0_CDA PD0/A; MCI0_CK PD9/A; MCI0_DA{n} PD{n+1}/A (n=0..7)
HSMCI1 at 0xF8000000 (HSMCI)
  pins: MCI1_CDA PB19/A; MCI1_CK PB24/A; MCI1_DA0 PB20/A; MCI1_DA1 PB21/A; MCI1_DA2 PB22/A; MCI1_DA3 PB23/A
HSMCI2 at 0xF8004000 (HSMCI)
  pins: MCI2_CDA PC10/A; MCI2_CK PC15/A; MCI2_DA0 PC11/A; MCI2_DA1 PC12/A; MCI2_DA2 PC13/A; MCI2_DA3 PC14/A
ISI at 0xF0034000
  pins: ISI_D{n} PA{n+16}/C (n=0..7); ISI_D8 PC29/C; ISI_D9 PC28/C; ISI_D10 PC27/C; ISI_D11 PC26/C; ISI_HSYNC PA31/C; ISI_PCK PC30/C; ISI_VSYNC PA30/C
MATRIX at 0xFFFFEC00
MPDDRC at 0xFFFFEA00
PIOA at 0xFFFFF200 (PIO)
PIOB at 0xFFFFF400 (PIO)
PIOC at 0xFFFFF600 (PIO)
PIOD at 0xFFFFF800 (PIO)
PIOE at 0xFFFFFA00 (PIO)
PIT at 0xFFFFFE30
PMC at 0xFFFFFC00
  pins: PCK0 PD30/B; PCK1 PD31/B; PCK2 PC15/B
PWM at 0xF002C000
  pins: PWMFI0 PC28/B; PWMFI1 PC31/B; PWMFI2 PC29/B; PWMFI3 PD16/C; PWMH0 PA20/B or PB0/B; PWMH1 PA22/B or PB4/B or PB27/C; PWMH2 PB8/B or PD5/C; PWMH3 PB12/B or PD7/C; PWML0 PA21/B or PB1/B; PWML1 PA23/B or PB5/B or PE31/B; PWML2 PB9/B or PD6/C; PWML3 PB13/B or PD8/C
RSTC at 0xFFFFFE00
RTC at 0xFFFFFEB0
SCKC at 0xFFFFFE50
SFR at 0xF0038000
SHDWC at 0xFFFFFE10
SMC at 0xFFFFC000
SMD at 0x00400000
SPI0 at 0xF0004000 (SPI)
  pins: SPI0_MISO PD10/A; SPI0_MOSI PD11/A; SPI0_NPCS0 PD13/A; SPI0_NPCS1 PD14/B; SPI0_NPCS2 PD15/B; SPI0_NPCS3 PD16/B; SPI0_SPCK PD12/A
SPI1 at 0xF8008000 (SPI)
  pins: SPI1_MISO PC22/A; SPI1_MOSI PC23/A; SPI1_NPCS0 PC25/A; SPI1_NPCS1 PC26/A; SPI1_NPCS2 PC27/A; SPI1_NPCS3 PC28/A; SPI1_SPCK PC24/A
SSC0 at 0xF0008000 (SSC)
  pins: RD0 PC21/A; RF0 PC20/A; RK0 PC19/A; TD0 PC18/A; TF0 PC17/A; TK0 PC16/A
SSC1 at 0xF800C000 (SSC)
  pins: RD1 PB11/B; RF1 PB10/B; RK1 PB7/B; TD1 PB6/B; TF1 PB3/B; TK1 PB2/B
TC0 at 0xF0010000 (TC)
  pins: TCLK0 PD7/B; TCLK1 PC14/B; TCLK2 PE29/B; TIOA0 PD5/B; TIOA1 PC12/B; TIOA2 PE27/B; TIOB0 PD6/B; TIOB1 PC13/B; TIOB2 PE28/B
TC1 at 0xF8014000 (TC)
  pins: TCLK3 PC2/B; TCLK4 PC5/B; TCLK5 PC8/B; TIOA3 PC0/B; TIOA4 PC3/B; TIOA5 PC6/B; TIOB3 PC1/B; TIOB4 PC4/B; TIOB5 PC7/B
TRNG at 0xF8040000
TWI0 at 0xF0014000 (TWI)
  pins: TWCK0 PA31/A; TWD0 PA30/A
TWI1 at 0xF0018000 (TWI)
  pins: TWCK1 PC27/B; TWD1 PC26/B
TWI2 at 0xF801C000 (TWI)
  pins: TWCK2 PA19/B; TWD2 PA18/B
UART0 at 0xF0024000 (UART)
  pins: URXD0 PC29/A; UTXD0 PC30/A
UART1 at 0xF8028000 (UART)
  pins: URXD1 PA30/B; UTXD1 PA31/B
UDPHS at 0xF8030000
USART0 at 0xF001C000 (USART)
  pins: CTS0 PD15/A; RTS0 PD16/A; RXD0 PD17/A; SCK0 PD14/A; TXD0 PD18/A
USART1 at 0xF0020000 (USART)
  pins: CTS1 PB26/A; RTS1 PB27/A; RXD1 PB28/A; SCK1 PB25/A; TXD1 PB29/A
USART2 at 0xF8020000 (USART)
  pins: CTS2 PE23/B; RTS2 PE24/B; RXD2 PE25/B; SCK2 PE20/B; TXD2 PE26/B
USART3 at 0xF8024000 (USART)
  pins: CTS3 PE16/B; RTS3 PE17/B; RXD3 PE18/B; SCK3 PE15/B; TXD3 PE19/B
WDT at 0xFFFFFE40

## Properties
SIGNATURES: JTAGID=0x05B3103F, CHIPID_CIDR=0x8A5C07C1, CHIPID_EXID=0x00584300

## Notices in the file
Copyright (c) 2012, Atmel Corporation
All rights reserved.
Redistribution and use in source and binary forms, with or without
modification, are permitted provided that the following condition is met:
- Redistributions of source code must retain the above copyright notice,
this list of conditions and the disclaimer below.
Atmel's name may not be used to endorse or promote products derived from
this software without specific prior written permission.
DISCLAIMER: THIS SOFTWARE IS PROVIDED BY ATMEL "AS IS" AND ANY EXPRESS OR
IMPLIED WARRANTIES, INCLUDING, BUT NOT LIMITED TO, THE IMPLIED WARRANTIES OF
MERCHANTABILITY, FITNESS FOR A PARTICULAR PURPOSE AND NON-INFRINGEMENT ARE
DISCLAIMED. IN NO EVENT SHALL ATMEL BE LIABLE FOR ANY DIRECT, INDIRECT,
INCIDENTAL, SPECIAL, EXEMPLARY, OR CONSEQUENTIAL DAMAGES (INCLUDING, BUT NOT
LIMITED TO, PROCUREMENT OF SUBSTITUTE GOODS OR SERVICES; LOSS OF USE, DATA,
OR PROFITS; OR BUSINESS INTERRUPTION) HOWEVER CAUSED AND ON ANY THEORY OF
LIABILITY, WHETHER IN CONTRACT, STRICT LIABILITY, OR TORT (INCLUDING
NEGLIGENCE OR OTHERWISE) ARISING IN ANY WAY OUT OF THE USE OF THIS SOFTWARE,
EVEN IF ADVISED OF THE POSSIBILITY OF SUCH DAMAGE.
